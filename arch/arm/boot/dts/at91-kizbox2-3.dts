// SPDX-License-Identifier: GPL-2.0
/*
 * Copyright (C) 2015 Overkiz SAS
 *   Author: Antoine Aubert <a.aubert@overkiz.com>
 *           Kévin Raymond <k.raymond@overkiz.com>
 */
/dts-v1/;
#include "at91-kizbox2_common.dtsi"

/ {
	model = "Overkiz Kizbox 2 with three heads";
	compatible = "overkiz,kizbox2-3", "atmel,sama5d31", "atmel,sama5d3", "atmel,sama5";
};

&usart0 {
	status = "okay";
};

&usart1 {
	status = "okay";
};

&usart2 {
	status = "okay";
};
